## CMakeLists.txt
```
# Copyright (c) 2026 Muhammad Waleed Badar
# SPDX-License-Identifier: Apache-2.0

cmake_minimum_required(VERSION 3.20.0)

find_package(Zephyr REQUIRED HINTS $ENV{ZEPHYR_BASE})
project(ocpp_sim_app LANGUAGES C)

target_sources(app PRIVATE
  src/main.c
  src/config.c
  src/cp.c
  src/evse.c
  src/net.c
  src/ui.c
  src/url.c
)

# Montserrat Bold for the headlines, as an array for LVGL's TinyTTF
generate_inc_file_for_target(app
  fonts/Montserrat-Bold-latin.ttf
  ${ZEPHYR_BINARY_DIR}/include/generated/montserrat_bold.ttf.inc)

# Link state and transaction id come from the OCPP library's own structures
# until it has an API for them: one file, behind one option.
if(CONFIG_OCPP_SIM_APP_PEEK)
  target_sources(app PRIVATE src/ocpp_peek.c)
  set_source_files_properties(src/ocpp_peek.c PROPERTIES
    INCLUDE_DIRECTORIES ${ZEPHYR_BASE}/subsys/net/lib/ocpp)
endif()

# native_sim: command line options (backend, screenshots) and the host clock
target_sources_ifdef(CONFIG_BOARD_NATIVE_SIM app PRIVATE src/host.c)

# The "sim" commands
target_sources_ifdef(CONFIG_SHELL app PRIVATE src/sim_shell.c)

# Boards with Wi-Fi: join the stored network
target_sources_ifdef(CONFIG_WIFI app PRIVATE src/wifi.c)
```

## Kconfig
```
# Copyright (c) 2026 Muhammad Waleed Badar
# SPDX-License-Identifier: Apache-2.0

mainmenu "OCPP charge point simulator"

config OCPP_SIM_APP_CONNECTORS
	int "Number of connectors"
	default 2
	range 1 4

config OCPP_SIM_APP_MAX_POWER_W
	int "Rating of a connector (W)"
	default 11000
	range 1 1000000

config OCPP_SIM_APP_VOLTAGE_V
	int "Phase voltage (V)"
	default 230
	range 1 1000

config OCPP_SIM_APP_PHASES
	int "Number of phases"
	default 3
	range 1 3

config OCPP_SIM_APP_AUTH_TIMEOUT_S
	int "Drop an accepted identifier if no EV plugs in (s)"
	default 30
	range 1 3600
	help
	  The ConnectionTimeOut of OCPP 1.6.

config OCPP_SIM_APP_URL
	string "Backend URL until one is saved"
	default "ws://127.0.0.1:8081"
	help
	  ws://host[:port][/path] of the central system. The charge box
	  identity is appended as the last path segment. The default is the
	  unauthenticated WebSocket server of a local CitrineOS
	  (tools/citrineos/compose.yml). Empty: the simulator waits until a
	  URL is entered on the display or with "sim url".

config OCPP_SIM_APP_CHARGE_BOX_ID
	string "Charge box identity until one is saved"
	default "zephyr-sim-01"

config OCPP_SIM_APP_ID_TAG_PREFIX
	string "Identifier (RFID) presented at a connector until one is saved"
	default "ZEPHYR-"
	help
	  The connector number is appended: ZEPHYR-1, ZEPHYR-2. At most 19
	  characters. The central system has to know the identifiers, see
	  tools/citrine.py.

config OCPP_SIM_APP_VENDOR
	string "chargePointVendor of the BootNotification (at most 20 characters)"
	default "Zephyr"

config OCPP_SIM_APP_MODEL
	string "chargePointModel of the BootNotification (at most 20 characters)"
	default "ocpp-sim"

config OCPP_SIM_APP_SERIAL
	string "chargePointSerialNumber of the BootNotification (at most 25 characters)"
	default "SIM-0001"

config OCPP_SIM_APP_REQUEST_TIMEOUT_MS
	int "Time to wait for the answer to Authorize, Start- and StopTransaction (ms)"
	default 8000

config OCPP_SIM_APP_SNTP_SERVER
	string "SNTP server for the timestamps"
	default "pool.ntp.org"
	depends on SNTP

config OCPP_SIM_APP_PEEK
	bool "Read link state and transaction id from the OCPP library's internals"
	default y
	help
	  The library has no API for "is the central system connected" or
	  for the transaction id it got from StartTransaction. With this
	  option app/src/ocpp_peek.c includes the library's private header
	  and reads them from its structures. Disable it if that header
	  changes; the display then shows the link state it can infer from
	  the requests and no transaction id.

config OCPP_SIM_APP_THREAD_STACK_SIZE
	int "Stack of the thread that talks to the central system"
	default 6144

source "Kconfig.zephyr"
```

## sample.yaml
```
# Copyright (c) 2026 Muhammad Waleed Badar
# SPDX-License-Identifier: Apache-2.0

sample:
  name: OCPP charge point simulator
tests:
  app.ocpp_sim:
    build_only: true
    platform_allow:
      - native_sim/native/64
      - uedx32480035e_wb_a/esp32s3/procpu
    integration_platforms:
      - native_sim/native/64
    tags:
      - ocpp
      - lvgl
```

## prj.conf
```kconfig
# Copyright (c) 2026 Muhammad Waleed Badar
# SPDX-License-Identifier: Apache-2.0

# --- Kernel ---------------------------------------------------------------------
# The main thread runs LVGL; a lower priority than the OCPP threads (7), the
# network stack and the shell.
CONFIG_MAIN_THREAD_PRIORITY=10
CONFIG_MAIN_STACK_SIZE=16384
CONFIG_HEAP_MEM_POOL_SIZE=65536
CONFIG_LOG=y
CONFIG_LOG_DEFAULT_LEVEL=3
# The OCPP library logs through the network log
CONFIG_NET_LOG=y
CONFIG_REBOOT=y

# --- OCPP 1.6J charge point (Zephyr subsys/net/lib/ocpp) -----------------------
CONFIG_NETWORKING=y
CONFIG_NET_IPV4=y
CONFIG_NET_IPV6=n
CONFIG_NET_TCP=y
CONFIG_NET_SOCKETS=y
CONFIG_ZVFS_POLL_MAX=8
CONFIG_HTTP_CLIENT=y
CONFIG_WEBSOCKET_CLIENT=y
CONFIG_JSON_LIBRARY=y
CONFIG_OCPP=y

# --- Backend URL, identity and identifiers on flash --------------------------
CONFIG_FLASH=y
CONFIG_FLASH_MAP=y
CONFIG_NVS=y
CONFIG_SETTINGS=y
CONFIG_SETTINGS_NVS=y

# --- "sim" commands on the console -------------------------------------------
CONFIG_SHELL=y
# The log goes to the console's own backend, from the first line on; through
# the shell everything logged before the shell runs would be lost.
CONFIG_SHELL_LOG_BACKEND=n

# --- Display and touch (LVGL) --------------------------------------------------
CONFIG_DISPLAY=y
CONFIG_INPUT=y
CONFIG_INPUT_QUEUE_MAX_MSGS=64
CONFIG_INPUT_THREAD_STACK_SIZE=2048
CONFIG_LVGL=y
CONFIG_LV_Z_POINTER_INPUT=y
CONFIG_LV_Z_POINTER_INPUT_MSGQ_COUNT=64
CONFIG_LV_Z_MEM_POOL_SIZE=131072
CONFIG_LV_USE_LABEL=y
CONFIG_LV_USE_BAR=y
CONFIG_LV_USE_SWITCH=y
CONFIG_LV_USE_TEXTAREA=y
CONFIG_LV_USE_KEYBOARD=y
CONFIG_LV_USE_BUTTONMATRIX=y
CONFIG_LV_USE_QRCODE=y
CONFIG_LV_USE_FLEX=y
# Headlines and numbers: Montserrat Bold (app/fonts) rendered by TinyTTF at
# the sizes the display calls for. Text and icons: the built-in fonts.
CONFIG_LV_USE_TINY_TTF=y
CONFIG_LV_FONT_MONTSERRAT_10=y
CONFIG_LV_FONT_MONTSERRAT_12=y
CONFIG_LV_FONT_MONTSERRAT_14=y
CONFIG_LV_FONT_MONTSERRAT_20=y
CONFIG_LV_FONT_MONTSERRAT_28=y
CONFIG_LV_FONT_DEFAULT_MONTSERRAT_14=y
```

## boards/native_sim_native_64.conf
```kconfig
# Copyright (c) 2026 Muhammad Waleed Badar
# SPDX-License-Identifier: Apache-2.0
#
# native_sim/native/64: the SDL window is the display, the mouse the touch
# screen, the terminal the console ("sim" commands) and the sockets are the
# host's, so the simulator reaches a central system on this machine or the
# network without any interface set-up.

CONFIG_NET_DRIVERS=y
CONFIG_ETH_NATIVE_TAP=n
CONFIG_NET_SOCKETS_OFFLOAD=y
CONFIG_NET_NATIVE_OFFLOADED_SOCKETS=y

CONFIG_LV_COLOR_DEPTH_32=y
# Room for lv_snapshot_take() of the whole screen (--shot)
CONFIG_LV_USE_SNAPSHOT=y
CONFIG_LV_Z_MEM_POOL_SIZE=4194304

# The console on the terminal that started the simulator
CONFIG_UART_NATIVE_PTY_0_ON_STDINOUT=y

# "Restart" starts the executable again, with the same command line
CONFIG_NATIVE_SIM_REBOOT=y
```

## socs/esp32s3_procpu.conf
```kconfig
# Copyright (c) 2026 Muhammad Waleed Badar
# SPDX-License-Identifier: Apache-2.0
#
# ESP32-S3 boards with PSRAM: Wi-Fi in place of the host's sockets, no shell.

# The console carries the log only; the display does what "sim" would
CONFIG_SHELL=n

# --- Wi-Fi ----------------------------------------------------------------
# wifi.c joins the network at every start: one kept on flash by the
# wifi_credentials library, or the one given to the build with
#   CONFIG_WIFI_CREDENTIALS_STATIC=y
#   CONFIG_WIFI_CREDENTIALS_STATIC_SSID, CONFIG_WIFI_CREDENTIALS_STATIC_PASSWORD
CONFIG_WIFI=y
CONFIG_WIFI_CREDENTIALS=y
CONFIG_WIFI_CREDENTIALS_CONNECT_STORED=y
CONFIG_NET_MGMT=y
CONFIG_NET_MGMT_EVENT=y
CONFIG_NET_MGMT_EVENT_INFO=y
# The ESP32 driver starts up in the context of the connect request, which
# runs on the system work queue
CONFIG_SYSTEM_WORKQUEUE_STACK_SIZE=4096

CONFIG_NET_UDP=y
CONFIG_NET_DHCPV4=y
CONFIG_DNS_RESOLVER=y
# cp.c waits for an address before it looks up the backend
CONFIG_NET_CONNECTION_MANAGER=y
# No clock on the board: the OCPP timestamps come from SNTP
CONFIG_SNTP=y

# --- Stacks ---------------------------------------------------------------
# The log thread overflows its default of 1 KB here, which hangs the system
# without a message
CONFIG_LOG_PROCESS_THREAD_STACK_SIZE=2048
CONFIG_NET_CONNECTION_MANAGER_MONITOR_STACK_SIZE=1024

# --- Memory ---------------------------------------------------------------
# LVGL and Wi-Fi do not fit into the internal RAM together: the Wi-Fi and
# network buffers and the LVGL memory pool go to the PSRAM (the SoC linker
# script places .lvgl_heap there). The render buffer stays in internal RAM,
# the display's SPI driver sends it with DMA.
CONFIG_ESP_WIFI_HEAP_SPIRAM=y
CONFIG_ESP32_WIFI_NET_ALLOC_SPIRAM=y
CONFIG_LV_Z_MEMORY_POOL_CUSTOM_SECTION=y
# The 128 KB of prj.conf run out while TinyTTF renders the first screen: an
# assertion in its rasteriser then stops the system
CONFIG_LV_Z_MEM_POOL_SIZE=1048576

# TinyTTF computes in floating point on the main thread: keep its registers
# across switches to other threads that use the FPU
CONFIG_FPU=y
CONFIG_FPU_SHARING=y
```

## boards/native_sim_native_64.overlay
```dts
/*
 * Copyright (c) 2026 Muhammad Waleed Badar
 * SPDX-License-Identifier: Apache-2.0
 *
 * A 800x480 window; overlays/ has the geometry of smaller displays.
 */
&sdl_dc {
	width = <800>;
	height = <480>;
};
```

## boards/uedx32480035e_wb_a_esp32s3_procpu.overlay
```dts
/*
 * Copyright (c) 2026 Muhammad Waleed Badar
 * SPDX-License-Identifier: Apache-2.0
 *
 * VIEWE UEDX32480035E-WB-A in landscape (480x320).
 */

/*
 * MADCTL: MV (0x20) exchanges rows and columns, BGR (0x08) is the colour
 * order of the panel. The board's portrait value is 0x48 (MX | BGR). If the
 * picture is upside down for the way the board is mounted, use 0xe8
 * (MY | MX | MV | BGR), and for the touch "inverted-y" instead of
 * "inverted-x".
 */
&st7796s {
	width = <480>;
	height = <320>;
	pgc = [f0 06 0b 07 06 05 2e 33 47 3a 17 16 2e 31];
	ngc = [f0 09 0d 09 08 23 2e 33 46 38 13 13 2c 32];
	madctl = <0x28>;
};

/*
 * The touch controller keeps reporting in the panel's own 320x480 space.
 * Landscape x is the panel's y, and landscape y runs against the panel's x.
 */
&chsc6x {
	screen-width = <320>;
	screen-height = <480>;
	inverted-x;
	swapped-x-y;
};

/* Not used; frees the driver's memory */
&sdhc0 {
	status = "disabled";
};
```

## src/main.c
```c
/*
 * Copyright (c) 2026 Muhammad Waleed Badar
 * SPDX-License-Identifier: Apache-2.0
 *
 * OCPP 1.6 charge point simulator: Zephyr's OCPP library, simulated
 * connectors and an LVGL front end to plug in, authorise and charge.
 */

#include <zephyr/device.h>
#include <zephyr/drivers/display.h>
#include <zephyr/kernel.h>
#include <zephyr/logging/log.h>

#include <lvgl.h>

#include "config.h"
#include "cp.h"
#include "host.h"
#include "ui.h"
#include "wifi.h"

LOG_MODULE_REGISTER(main, LOG_LEVEL_INF);

#define REFRESH_MS 200

int main(void)
{
	const struct device *display = DEVICE_DT_GET(DT_CHOSEN(zephyr_display));
	int64_t next_refresh = 0;

	if (!device_is_ready(display)) {
		LOG_ERR("display not ready");
		return 0;
	}

	(void)config_init();
	host_init();
	wifi_init();

	LOG_INF("OCPP 1.6 charge point simulator, %d connectors", CP_CONNECTORS);
	cp_init();

	ui_init();
	ui_refresh();
	lv_timer_handler();
	display_blanking_off(display);

	for (;;) {
		int64_t now = k_uptime_get();
		uint32_t idle;

		if (now >= next_refresh) {
			next_refresh = now + REFRESH_MS;
			ui_refresh();
		}

		idle = lv_timer_handler();
		host_poll(now);

		k_msleep(CLAMP(idle, 5, 20));
	}

	return 0;
}
```

## src/config.c
```c
/*
 * Copyright (c) 2026 Muhammad Waleed Badar
 * SPDX-License-Identifier: Apache-2.0
 */

#include "config.h"

#include <errno.h>
#include <stdio.h>
#include <stdlib.h>
#include <string.h>

#include <zephyr/kernel.h>
#include <zephyr/logging/log.h>
#include <zephyr/settings/settings.h>

#include "url.h"

LOG_MODULE_REGISTER(config, LOG_LEVEL_INF);

static struct app_config cfg;
static K_MUTEX_DEFINE(lock);

static void copy(char *dst, size_t size, const char *src)
{
	strncpy(dst, src, size - 1);
	dst[size - 1] = '\0';
}

static int read_string(settings_read_cb read_cb, void *cb_arg, size_t len, char *dst, size_t size)
{
	ssize_t n;

	if (len >= size) {
		return -ENAMETOOLONG;
	}
	n = read_cb(cb_arg, dst, len);
	if (n < 0) {
		return (int)n;
	}
	dst[n] = '\0';

	return 0;
}

static int settings_set(const char *name, size_t len, settings_read_cb read_cb, void *cb_arg)
{
	const char *next;

	if (settings_name_steq(name, "url", &next) && next == NULL) {
		return read_string(read_cb, cb_arg, len, cfg.url, sizeof(cfg.url));
	}
	if (settings_name_steq(name, "cbid", &next) && next == NULL) {
		return read_string(read_cb, cb_arg, len, cfg.cbid, sizeof(cfg.cbid));
	}
	if (settings_name_steq(name, "tag", &next) && next != NULL) {
		int connector = atoi(next);

		if (connector < 1 || connector > CONFIG_OCPP_SIM_APP_CONNECTORS) {
			return -ENOENT;
		}
		return read_string(read_cb, cb_arg, len, cfg.idtag[connector - 1],
				   sizeof(cfg.idtag[0]));
	}

	return -ENOENT;
}

SETTINGS_STATIC_HANDLER_DEFINE(sim, "sim", NULL, settings_set, NULL, NULL);

int config_init(void)
{
	int ret;

	copy(cfg.url, sizeof(cfg.url), CONFIG_OCPP_SIM_APP_URL);
	copy(cfg.cbid, sizeof(cfg.cbid), CONFIG_OCPP_SIM_APP_CHARGE_BOX_ID);
	for (int i = 0; i < CONFIG_OCPP_SIM_APP_CONNECTORS; i++) {
		snprintf(cfg.idtag[i], sizeof(cfg.idtag[i]), "%s%d",
			 CONFIG_OCPP_SIM_APP_ID_TAG_PREFIX, i + 1);
	}

	ret = settings_subsys_init();
	if (ret < 0) {
		LOG_ERR("settings: %d, running on the defaults", ret);
		return ret;
	}

	return settings_load_subtree("sim");
}

void config_get(struct app_config *out)
{
	k_mutex_lock(&lock, K_FOREVER);
	*out = cfg;
	k_mutex_unlock(&lock);
}

static int store(const char *key, char *dst, size_t size, const char *value)
{
	int ret;

	k_mutex_lock(&lock, K_FOREVER);
	copy(dst, size, value);
	k_mutex_unlock(&lock);

	ret = settings_save_one(key, value, strlen(value));
	if (ret < 0) {
		LOG_ERR("saving %s: %d", key, ret);
	}

	return ret;
}

int config_set_url(const char *url)
{
	struct backend_url parsed;
	int ret;

	if (strlen(url) > CONFIG_URL_MAX) {
		return -ENAMETOOLONG;
	}
	/* empty is allowed: the simulator then stays off line */
	if (url[0] != '\0') {
		ret = backend_url_parse(url, &parsed);
		if (ret < 0) {
			return ret;
		}
	}

	return store("sim/url", cfg.url, sizeof(cfg.url), url);
}

int config_set_cbid(const char *cbid)
{
	if (strlen(cbid) > CONFIG_CBID_MAX) {
		return -ENAMETOOLONG;
	}

	return store("sim/cbid", cfg.cbid, sizeof(cfg.cbid), cbid);
}

int config_set_idtag(int connector, const char *idtag)
{
	char key[16];
	size_t len = strlen(idtag);

	if (connector < 1 || connector > CONFIG_OCPP_SIM_APP_CONNECTORS || len == 0) {
		return -EINVAL;
	}
	if (len > EVSE_IDTAG_MAX) {
		return -ENAMETOOLONG;
	}

	snprintf(key, sizeof(key), "sim/tag/%d", connector);

	return store(key, cfg.idtag[connector - 1], sizeof(cfg.idtag[0]), idtag);
}

void config_override(const char *url, const char *cbid)
{
	k_mutex_lock(&lock, K_FOREVER);
	if (url != NULL) {
		copy(cfg.url, sizeof(cfg.url), url);
	}
	if (cbid != NULL) {
		copy(cfg.cbid, sizeof(cfg.cbid), cbid);
	}
	k_mutex_unlock(&lock);
}
```

## src/config.h
```c
/*
 * Copyright (c) 2026 Muhammad Waleed Badar
 * SPDX-License-Identifier: Apache-2.0
 *
 * What the simulator remembers across restarts: the backend URL, the
 * charge box identity and the identifier presented at each connector.
 */
#ifndef OCPP_SIM_APP_CONFIG_H_
#define OCPP_SIM_APP_CONFIG_H_

#include "evse.h"

#define CONFIG_URL_MAX  192
#define CONFIG_CBID_MAX 48

struct app_config {
	char url[CONFIG_URL_MAX + 1];
	char cbid[CONFIG_CBID_MAX + 1];
	char idtag[CONFIG_OCPP_SIM_APP_CONNECTORS][EVSE_IDTAG_MAX + 1];
};

/** Load the saved values over the Kconfig defaults. */
int config_init(void);

/** Copy of the current values. Any thread. */
void config_get(struct app_config *out);

/**
 * Change and save a value. The backend URL and the identity take effect at
 * the next start, the identifier with the next tap.
 *
 * @retval 0 saved
 * @retval -EINVAL, -EPROTONOSUPPORT, -ENAMETOOLONG not a usable value
 */
int config_set_url(const char *url);
int config_set_cbid(const char *cbid);
int config_set_idtag(int connector, const char *idtag);

/** Use these for this run without saving them (command line). */
void config_override(const char *url, const char *cbid);

#endif /* OCPP_SIM_APP_CONFIG_H_ */
```

## src/cp.c
```c
/*
 * Copyright (c) 2026 Muhammad Waleed Badar
 * SPDX-License-Identifier: Apache-2.0
 *
 * Threads that come through here:
 *
 *   main (LVGL), shell   inputs and readings, under "lock", never the network
 *   cp (this file)       takes the requests the connector models hand out and
 *                        makes them with ocpp_authorize() and friends, which
 *                        block until the central system answers
 *   OCPP library         notify(): remote start/stop, unlock, meter readings
 *
 * "lock" is never held across a call into the OCPP library.
 */

#include "cp.h"

#include <errno.h>
#include <stdio.h>
#include <string.h>

#include <zephyr/kernel.h>
#include <zephyr/logging/log.h>
#include <zephyr/net/ocpp.h>
#include <zephyr/version.h>

#include "config.h"
#include "net.h"
#include "ocpp_peek.h"

LOG_MODULE_REGISTER(cp, LOG_LEVEL_INF);

#define REQUEST_TIMEOUT_MS CONFIG_OCPP_SIM_APP_REQUEST_TIMEOUT_MS

/* The OCPP library of Zephyr 4.5 keeps the identifier in 20 bytes, which
 * leaves one of 20 characters without its terminator: the StartTransaction
 * then goes out malformed. Later versions have room for it.
 */
#if KERNEL_VERSION_NUMBER < ZEPHYR_VERSION(4, 5, 99)
#define LIB_IDTAG_MAX (EVSE_IDTAG_MAX - 1)
#else
#define LIB_IDTAG_MAX EVSE_IDTAG_MAX
#endif
#define POLL_MS            250
#define RETRY_MS           5000

static struct evse evse[CP_CONNECTORS];
static ocpp_session_handle_t session[CP_CONNECTORS];
static struct cp_status link_status;
static bool ocpp_up;

static K_MUTEX_DEFINE(lock);
static K_SEM_DEFINE(wake, 0, 1);

static K_THREAD_STACK_DEFINE(cp_stack, CONFIG_OCPP_SIM_APP_THREAD_STACK_SIZE);
static struct k_thread cp_thread_data;

static bool valid(int connector)
{
	return connector >= 1 && connector <= CP_CONNECTORS;
}

const char *cp_link_str(enum cp_link link)
{
	switch (link) {
	case CP_LINK_UNCONFIGURED:
		return "No backend";
	case CP_LINK_NO_NETWORK:
		return "No network";
	case CP_LINK_RESOLVING:
		return "Resolving";
	case CP_LINK_CONNECTING:
		return "Connecting";
	case CP_LINK_BOOTING:
		return "Booting";
	case CP_LINK_ONLINE:
		return "Online";
	default:
		return "?";
	}
}

static void set_link(enum cp_link link)
{
	enum cp_link before;

	k_mutex_lock(&lock, K_FOREVER);
	before = link_status.link;
	link_status.link = link;
	k_mutex_unlock(&lock);

	if (before == link) {
		return;
	}

	switch (link) {
	case CP_LINK_ONLINE:
		LOG_INF("BootNotification accepted, heartbeat every %d s",
			  link_status.heartbeat_s);
		break;
	case CP_LINK_BOOTING:
		LOG_INF("Connected, waiting for the BootNotification answer");
		break;
	case CP_LINK_CONNECTING:
		if (before == CP_LINK_ONLINE || before == CP_LINK_BOOTING) {
			LOG_WRN("Connection to the central system lost");
		}
		break;
	default:
		break;
	}
}

/* ---- inputs and readings (any thread) ---------------------------------- */

void cp_get_status(struct cp_status *status)
{
	k_mutex_lock(&lock, K_FOREVER);
	*status = link_status;
	k_mutex_unlock(&lock);
}

void cp_get_connector(int connector, struct cp_connector *view)
{
	struct evse *e;

	memset(view, 0, sizeof(*view));
	view->txn_id = -1;
	view->last_txn_id = -1;
	if (!valid(connector)) {
		return;
	}
	e = &evse[connector - 1];

	k_mutex_lock(&lock, K_FOREVER);
	evse_advance(e, k_uptime_get());
	view->status = evse_status(e);
	view->auth = e->auth;
	view->txn = e->txn;
	view->stop_reason = e->stop_reason;
	view->ev_plugged = e->ev_plugged;
	view->ev_ready = e->ev_ready;
	view->evse_ready = e->evse_ready;
	view->faulted = e->faulted;
	view->inoperative = e->inoperative;
	strcpy(view->idtag, e->idtag);
	view->txn_id = e->txn_id;
	view->last_txn_id = e->last_txn_id;
	view->power_w = e->power_w;
	view->energy_wh = evse_energy_wh(e);
	view->session_wh = evse_session_wh(e);
	view->session_s = evse_session_s(e);
	view->current_ma = evse_current_ma(e);
	view->offered_ma = evse_offered_ma(e);
	view->limit_w = e->limit_w;
	view->max_power_w = e->cfg.max_power_w;
	view->voltage_v = evse_voltage_v(e);
	k_mutex_unlock(&lock);
}

#define CP_INPUT(name, type, call)                                                                 \
	void name(int connector, type value)                                                       \
	{                                                                                          \
		if (!valid(connector)) {                                                           \
			return;                                                                    \
		}                                                                                  \
		k_mutex_lock(&lock, K_FOREVER);                                                    \
		call(&evse[connector - 1], value, k_uptime_get());                                 \
		k_mutex_unlock(&lock);                                                             \
		k_sem_give(&wake);                                                                 \
	}

CP_INPUT(cp_set_plugged, bool, evse_set_plugged)
CP_INPUT(cp_set_ev_ready, bool, evse_set_ev_ready)
CP_INPUT(cp_set_evse_ready, bool, evse_set_evse_ready)
CP_INPUT(cp_set_fault, bool, evse_set_fault)
CP_INPUT(cp_set_inoperative, bool, evse_set_inoperative)
CP_INPUT(cp_set_limit, uint32_t, evse_set_limit)

int cp_present_tag(int connector, const char *idtag)
{
	struct app_config cfg;
	int ret;

	if (!valid(connector)) {
		return -EINVAL;
	}
	if (idtag == NULL) {
		config_get(&cfg);
		idtag = cfg.idtag[connector - 1];
	}

	k_mutex_lock(&lock, K_FOREVER);
	ret = evse_present_tag(&evse[connector - 1], idtag, k_uptime_get());
	k_mutex_unlock(&lock);
	k_sem_give(&wake);

	if (ret == -EBUSY) {
		LOG_WRN("C%d: %s ignored, the connector is busy", connector, idtag);
	} else if (ret == -EACCES) {
		LOG_WRN("C%d: %s ignored, the connector is not in service", connector, idtag);
	}

	return ret;
}

int cp_stop(int connector)
{
	int ret;

	if (!valid(connector)) {
		return -EINVAL;
	}

	k_mutex_lock(&lock, K_FOREVER);
	ret = evse_stop(&evse[connector - 1], EVSE_STOP_LOCAL, k_uptime_get());
	k_mutex_unlock(&lock);
	k_sem_give(&wake);

	return ret;
}

/* ---- OCPP library callback --------------------------------------------- */

static int meter_value(int connector, enum ocpp_meter_measurand measurand, char *val)
{
	struct evse *e;
	int ret = 0;

	if (!valid(connector)) {
		return -EINVAL;
	}
	e = &evse[connector - 1];

	k_mutex_lock(&lock, K_FOREVER);
	evse_advance(e, k_uptime_get());

	if (e->txn != EVSE_TXN_ACTIVE) {
		/* the library also asks for sessions that are only authorised */
		ret = -ENODATA;
	} else {
		switch (measurand) {
		case OCPP_OMM_ACTIVE_ENERGY_TO_EV:
			snprintf(val, CISTR50, "%u", evse_energy_wh(e));
			break;
		case OCPP_OMM_ACTIVE_POWER_TO_EV:
			snprintf(val, CISTR50, "%u", e->power_w);
			break;
		case OCPP_OMM_CURRENT_TO_EV: {
			uint32_t ma = evse_current_ma(e);

			snprintf(val, CISTR50, "%u.%u", ma / 1000, (ma % 1000) / 100);
			break;
		}
		case OCPP_OMM_VOLTAGE_AC_RMS:
			snprintf(val, CISTR50, "%u", evse_voltage_v(e));
			break;
		default:
			ret = -ENOTSUP;
			break;
		}
	}
	k_mutex_unlock(&lock);

	return ret;
}

static int remote_start(int connector, const char *idtag)
{
	int ret = -EBUSY;

	k_mutex_lock(&lock, K_FOREVER);
	if (!valid(connector)) {
		/* no connector named: the first one that is free, cable in first */
		connector = 0;
		for (int pass = 0; pass < 2 && connector == 0; pass++) {
			for (int i = 0; i < CP_CONNECTORS; i++) {
				if (evse_is_idle(&evse[i]) &&
				    (pass == 1 || evse[i].ev_plugged)) {
					connector = i + 1;
					break;
				}
			}
		}
	}
	if (valid(connector)) {
		ret = evse_remote_start(&evse[connector - 1], idtag, k_uptime_get());
	}
	k_mutex_unlock(&lock);

	if (ret == 0) {
		LOG_INF("C%d: RemoteStartTransaction %s", connector, idtag);
	} else {
		LOG_WRN("RemoteStartTransaction %s: no free connector (%d)", idtag, ret);
	}
	k_sem_give(&wake);

	return ret;
}

static int remote_stop(int connector, bool unlock)
{
	int ret;

	if (!valid(connector)) {
		return -EINVAL;
	}

	k_mutex_lock(&lock, K_FOREVER);
	ret = evse_stop(&evse[connector - 1], EVSE_STOP_REMOTE, k_uptime_get());
	k_mutex_unlock(&lock);

	LOG_INF("C%d: %s%s", connector, unlock ? "UnlockConnector" : "RemoteStopTransaction",
		  ret == 0 ? "" : ", nothing to stop");
	k_sem_give(&wake);

	return unlock ? 0 : ret;
}

static int notify(enum ocpp_notify_reason reason, union ocpp_io_value *io, void *user_data)
{
	ARG_UNUSED(user_data);

	switch (reason) {
	case OCPP_USR_GET_METER_VALUE:
		return meter_value(io->meter_val.id_con, io->meter_val.mes, io->meter_val.val);
	case OCPP_USR_START_CHARGING:
		return remote_start(io->start_charge.id_con, io->start_charge.idtag);
	case OCPP_USR_STOP_CHARGING:
		return remote_stop(io->stop_charge.id_con, false);
	case OCPP_USR_UNLOCK_CONNECTOR:
		/* a running transaction ends before the cable is released */
		return remote_stop(io->unlock_con.id_con, true);
	default:
		return -ENOTSUP;
	}
}

/* ---- requests to the central system (cp thread) ------------------------ */

static const char *auth_status_str(enum ocpp_auth_status status)
{
	switch (status) {
	case OCPP_AUTH_ACCEPTED:
		return "Accepted";
	case OCPP_AUTH_BLOCKED:
		return "Blocked";
	case OCPP_AUTH_EXPIRED:
		return "Expired";
	case OCPP_AUTH_CONCURRENT_TX:
		return "ConcurrentTx";
	default:
		return "Invalid";
	}
}

static bool reachable(void)
{
	enum cp_link link;

	if (!ocpp_up) {
		return false;
	}

	k_mutex_lock(&lock, K_FOREVER);
	link = link_status.link;
	k_mutex_unlock(&lock);

	/* without the peek the state is a guess: let the library decide */
	return link == CP_LINK_ONLINE || !IS_ENABLED(CONFIG_OCPP_SIM_APP_PEEK);
}

static void do_authorize(int connector)
{
	struct evse *e = &evse[connector - 1];
	enum ocpp_auth_status status = OCPP_AUTH_INVALID;
	enum evse_result result = EVSE_RESULT_FAILED;
	char idtag[EVSE_IDTAG_MAX + 1];
	int ret = -ENOTCONN;

	k_mutex_lock(&lock, K_FOREVER);
	strcpy(idtag, e->idtag);
	k_mutex_unlock(&lock);

	if (strlen(idtag) > LIB_IDTAG_MAX) {
		LOG_WRN("C%d: %s is longer than the %d characters the OCPP library of this "
			"Zephyr can send",
			connector, idtag, LIB_IDTAG_MAX);
		result = EVSE_RESULT_REJECTED;
	} else {
		if (reachable()) {
			ret = ocpp_authorize(session[connector - 1], idtag, &status,
					     REQUEST_TIMEOUT_MS);
		}

		if (ret < 0) {
			LOG_WRN("C%d: Authorize %s: no answer (%d)", connector, idtag, ret);
		} else {
			LOG_INF("C%d: Authorize %s: %s", connector, idtag,
				auth_status_str(status));
			result = status == OCPP_AUTH_ACCEPTED ? EVSE_RESULT_ACCEPTED
							      : EVSE_RESULT_REJECTED;
		}
	}

	k_mutex_lock(&lock, K_FOREVER);
	evse_auth_result(e, result, k_uptime_get());
	k_mutex_unlock(&lock);
}

static void do_start(int connector)
{
	struct evse *e = &evse[connector - 1];
	enum evse_result result = EVSE_RESULT_FAILED;
	int txn_id = -1;
	int meter_wh;
	int ret = -ENOTCONN;

	k_mutex_lock(&lock, K_FOREVER);
	meter_wh = (int)evse_energy_wh(e);
	k_mutex_unlock(&lock);

	if (reachable()) {
		ret = ocpp_start_transaction(session[connector - 1], meter_wh, (uint8_t)connector,
					     REQUEST_TIMEOUT_MS);
	}

	if (ret == 0) {
		result = EVSE_RESULT_ACCEPTED;
		txn_id = ocpp_peek_txn_id(session[connector - 1]);
		if (txn_id >= 0) {
			LOG_INF("C%d: StartTransaction at %d Wh: transaction %d", connector,
				  meter_wh, txn_id);
		} else {
			LOG_INF("C%d: StartTransaction at %d Wh: accepted", connector, meter_wh);
		}
	} else if (ret == -EACCES) {
		result = EVSE_RESULT_REJECTED;
		LOG_INF("C%d: StartTransaction: not authorised", connector);
	} else {
		LOG_WRN("C%d: StartTransaction: no answer (%d)", connector, ret);
	}

	k_mutex_lock(&lock, K_FOREVER);
	evse_txn_started(e, result, txn_id, k_uptime_get());
	k_mutex_unlock(&lock);
}

static void do_stop(int connector)
{
	struct evse *e = &evse[connector - 1];
	enum evse_stop_reason reason;
	uint32_t session_wh;
	int meter_wh;
	int ret = -ENOTCONN;

	k_mutex_lock(&lock, K_FOREVER);
	meter_wh = (int)evse_energy_wh(e);
	session_wh = evse_session_wh(e);
	reason = e->stop_reason;
	k_mutex_unlock(&lock);

	if (ocpp_up) {
		ret = ocpp_stop_transaction(session[connector - 1], meter_wh, REQUEST_TIMEOUT_MS);
	}

	if (ret < 0) {
		LOG_WRN("C%d: StopTransaction (%s): no answer (%d), stopped here", connector,
			  evse_stop_reason_str(reason), ret);
	} else {
		LOG_INF("C%d: StopTransaction (%s) at %d Wh, %u Wh charged", connector,
			  evse_stop_reason_str(reason), meter_wh, session_wh);
	}

	/* the session is over for the connector whatever the backend said */
	k_mutex_lock(&lock, K_FOREVER);
	evse_txn_stopped(e, k_uptime_get());
	k_mutex_unlock(&lock);
}

static void service(int connector)
{
	struct evse *e = &evse[connector - 1];
	enum evse_request request;

	/* one request can lead to the next: Authorize, then StartTransaction */
	for (;;) {
		k_mutex_lock(&lock, K_FOREVER);
		evse_advance(e, k_uptime_get());
		request = evse_take_request(e);
		k_mutex_unlock(&lock);

		switch (request) {
		case EVSE_REQ_AUTHORIZE:
			do_authorize(connector);
			break;
		case EVSE_REQ_START_TXN:
			do_start(connector);
			break;
		case EVSE_REQ_STOP_TXN:
			do_stop(connector);
			break;
		default:
			return;
		}
	}
}

static void poll_link(void)
{
	enum ocpp_peek_link peek;
	int heartbeat_s = 0;

	if (!ocpp_up) {
		return;
	}

	peek = ocpp_peek_link(session[0], &heartbeat_s);
	switch (peek) {
	case OCPP_PEEK_ONLINE:
		k_mutex_lock(&lock, K_FOREVER);
		link_status.heartbeat_s = heartbeat_s;
		k_mutex_unlock(&lock);
		set_link(CP_LINK_ONLINE);
		break;
	case OCPP_PEEK_BOOTING:
		set_link(CP_LINK_BOOTING);
		break;
	case OCPP_PEEK_OFFLINE:
		set_link(CP_LINK_CONNECTING);
		break;
	default:
		break;
	}
}

/* Bring the OCPP library up. It cannot be stopped or pointed elsewhere
 * afterwards, which is why a new backend URL needs a restart.
 */
static int link_up(void)
{
	static char fw_version[32];
	struct ocpp_cp_info cpi = {
		.model = CONFIG_OCPP_SIM_APP_MODEL,
		.vendor = CONFIG_OCPP_SIM_APP_VENDOR,
		.num_of_con = CP_CONNECTORS,
		.sl_no = CONFIG_OCPP_SIM_APP_SERIAL,
		.fw_ver = fw_version,
	};
	struct ocpp_cs_info csi = {0};
	struct app_config cfg;
	struct cp_status st = {0};
	int ret;

	config_get(&cfg);
	if (cfg.url[0] == '\0') {
		LOG_WRN("No backend URL: set one on the OCPP page or with \"sim url\"");
		return -ENOENT;
	}

	ret = backend_url_parse(cfg.url, &st.url);
	if (ret == 0) {
		ret = backend_url_ws_path(&st.url, cfg.cbid, st.ws_path, sizeof(st.ws_path));
	}
	if (ret < 0) {
		LOG_WRN("Backend URL %s is not usable (%d)", cfg.url, ret);
		return -ENOENT;
	}
	if (st.url.tls != IS_ENABLED(CONFIG_NET_SOCKETS_SOCKOPT_TLS)) {
		LOG_WRN("%s needs a build %s TLS sockets", cfg.url,
			  st.url.tls ? "with" : "without");
		return -ENOENT;
	}

	st.link = CP_LINK_NO_NETWORK;
	k_mutex_lock(&lock, K_FOREVER);
	link_status = st;
	k_mutex_unlock(&lock);

	while (net_wait_ready(K_MSEC(RETRY_MS)) < 0) {
		LOG_INF("waiting for the network");
	}
	net_sync_time();

	set_link(CP_LINK_RESOLVING);
	while (net_resolve(st.url.host, st.ip, sizeof(st.ip)) < 0) {
		k_sleep(K_MSEC(RETRY_MS));
	}
	k_mutex_lock(&lock, K_FOREVER);
	strcpy(link_status.ip, st.ip);
	k_mutex_unlock(&lock);

	snprintf(fw_version, sizeof(fw_version), "zephyr-%s", KERNEL_VERSION_STRING);
	csi.cs_ip = st.ip;
	csi.ws_url = st.ws_path;
	csi.port = st.url.port;
	csi.sa_family = NET_AF_INET;

	ret = ocpp_init(&cpi, &csi, notify, NULL);
	if (ret < 0) {
		LOG_WRN("OCPP library did not start (%d)", ret);
		return ret;
	}

	for (int i = 0; i < CP_CONNECTORS; i++) {
		ret = ocpp_session_open(&session[i]);
		if (ret < 0) {
			LOG_WRN("OCPP session %d did not open (%d)", i + 1, ret);
			return ret;
		}
	}

	ocpp_up = true;
	LOG_INF("Connecting to %s://%s:%u%s", st.url.tls ? "wss" : "ws", st.url.host,
		  st.url.port, st.ws_path);
	set_link(CP_LINK_CONNECTING);

	return 0;
}

static void cp_thread(void *p1, void *p2, void *p3)
{
	ARG_UNUSED(p1);
	ARG_UNUSED(p2);
	ARG_UNUSED(p3);

	(void)link_up();

	for (;;) {
		(void)k_sem_take(&wake, K_MSEC(POLL_MS));
		poll_link();
		for (int connector = 1; connector <= CP_CONNECTORS; connector++) {
			service(connector);
		}
	}
}

int cp_init(void)
{
	static const struct evse_config cfg = {
		.max_power_w = CONFIG_OCPP_SIM_APP_MAX_POWER_W,
		.voltage_v = CONFIG_OCPP_SIM_APP_VOLTAGE_V,
		.phases = CONFIG_OCPP_SIM_APP_PHASES,
		.auth_timeout_s = CONFIG_OCPP_SIM_APP_AUTH_TIMEOUT_S,
	};
	int64_t now = k_uptime_get();

	for (int i = 0; i < CP_CONNECTORS; i++) {
		evse_init(&evse[i], (uint8_t)(i + 1), &cfg, now);
		/* a car that wants energy at a station that offers it: plugging in
		 * and starting is all it takes, the inputs are there to pause
		 */
		evse_set_ev_ready(&evse[i], true, now);
		evse_set_evse_ready(&evse[i], true, now);
	}

	k_thread_create(&cp_thread_data, cp_stack, K_THREAD_STACK_SIZEOF(cp_stack), cp_thread,
			NULL, NULL, NULL, 8, 0, K_NO_WAIT);
	k_thread_name_set(&cp_thread_data, "cp");

	return 0;
}
```

## src/cp.h
```c
/*
 * Copyright (c) 2026 Muhammad Waleed Badar
 * SPDX-License-Identifier: Apache-2.0
 *
 * The charge point: the simulated connectors (evse.c) joined to Zephyr's
 * OCPP 1.6 library. The display and the shell call in here; the
 * requests to the central system are made by a thread of this module, so
 * none of these functions waits for the network.
 */
#ifndef OCPP_SIM_APP_CP_H_
#define OCPP_SIM_APP_CP_H_

#include <stdbool.h>
#include <stdint.h>

#include "evse.h"
#include "url.h"

#define CP_CONNECTORS CONFIG_OCPP_SIM_APP_CONNECTORS

/** Where the connection to the central system stands. */
enum cp_link {
	CP_LINK_UNCONFIGURED, /**< no usable backend URL */
	CP_LINK_NO_NETWORK,   /**< waiting for an IP address */
	CP_LINK_RESOLVING,    /**< looking up the backend's address */
	CP_LINK_CONNECTING,   /**< WebSocket not (or no longer) open */
	CP_LINK_BOOTING,      /**< connected, BootNotification not accepted yet */
	CP_LINK_ONLINE,       /**< BootNotification accepted */
};

struct cp_status {
	enum cp_link link;
	int heartbeat_s;      /**< interval from the central system, 0 if unknown */
	struct backend_url url; /**< backend in use */
	char ws_path[BACKEND_URL_PATH_MAX + 64];
	char ip[48];          /**< address the host resolved to */
};

/** What the display shows of one connector. */
struct cp_connector {
	enum evse_status status;
	enum evse_auth auth;
	enum evse_txn txn;
	enum evse_stop_reason stop_reason;
	bool ev_plugged;
	bool ev_ready;
	bool evse_ready;
	bool faulted;
	bool inoperative;
	char idtag[EVSE_IDTAG_MAX + 1]; /**< of the session, or the last one */
	int32_t txn_id;                  /**< -1 without transaction or if unknown */
	int32_t last_txn_id;             /**< of the running or the last transaction */
	uint32_t power_w;
	uint32_t energy_wh;
	uint32_t session_wh;
	uint32_t session_s;
	uint32_t current_ma;
	uint32_t offered_ma;
	uint32_t limit_w;
	uint32_t max_power_w;
	uint16_t voltage_v;
};

/** Set the connectors up and start the thread that talks to the backend. */
int cp_init(void);

void cp_get_status(struct cp_status *status);
/** @p connector is 1..CP_CONNECTORS in all functions below. */
void cp_get_connector(int connector, struct cp_connector *view);

void cp_set_plugged(int connector, bool plugged);
void cp_set_ev_ready(int connector, bool ready);
void cp_set_evse_ready(int connector, bool ready);
void cp_set_fault(int connector, bool faulted);
void cp_set_inoperative(int connector, bool inoperative);
void cp_set_limit(int connector, uint32_t limit_w);

/**
 * Present an identifier; NULL takes the one configured for the connector.
 * See evse_present_tag() for what that does and returns.
 */
int cp_present_tag(int connector, const char *idtag);

/** Stop button: ends the transaction or withdraws the identifier. */
int cp_stop(int connector);

const char *cp_link_str(enum cp_link link);

#endif /* OCPP_SIM_APP_CP_H_ */
```

## src/evse.c
```c
/*
 * Copyright (c) 2026 Muhammad Waleed Badar
 * SPDX-License-Identifier: Apache-2.0
 */

#include "evse.h"

#include <errno.h>
#include <string.h>

#include <zephyr/sys/util.h>

/* W*ms in one Wh */
#define WMS_PER_WH 3600000ULL

/* The contactor is closed and the EV draws what the EVSE offers */
static bool delivering(const struct evse *e)
{
	return e->txn == EVSE_TXN_ACTIVE && e->ev_plugged && e->ev_ready && e->evse_ready &&
	       !e->faulted;
}

/* Recompute what follows from the inputs after any change */
static void settle(struct evse *e, int64_t now_ms)
{
	if (!e->ev_plugged) {
		e->finishing = false;
		if (e->txn == EVSE_TXN_ACTIVE) {
			e->txn = EVSE_TXN_STOPPING;
			e->request = EVSE_REQ_STOP_TXN;
			e->stop_reason = EVSE_STOP_EV_DISCONNECTED;
		} else if (e->txn == EVSE_TXN_STARTING && e->stop_pending == EVSE_STOP_NONE) {
			e->stop_pending = EVSE_STOP_EV_DISCONNECTED;
		}
	}

	if (e->auth == EVSE_AUTH_ACCEPTED && e->txn == EVSE_TXN_IDLE) {
		if (e->ev_plugged && !e->faulted && !e->inoperative) {
			e->txn = EVSE_TXN_STARTING;
			e->request = EVSE_REQ_START_TXN;
			e->stop_pending = EVSE_STOP_NONE;
			e->finishing = false;
		} else if (now_ms >= e->auth_deadline_ms) {
			/* ConnectionTimeOut: nobody plugged in */
			e->auth = EVSE_AUTH_NONE;
		}
	}

	e->power_w = delivering(e) ? MIN(e->limit_w, e->cfg.max_power_w) : 0;
}

void evse_init(struct evse *e, uint8_t id, const struct evse_config *cfg, int64_t now_ms)
{
	memset(e, 0, sizeof(*e));

	e->cfg = *cfg;
	if (e->cfg.phases == 0) {
		e->cfg.phases = 1;
	}
	e->id = id;
	e->txn_id = -1;
	e->last_txn_id = -1;
	e->limit_w = e->cfg.max_power_w;
	e->last_ms = now_ms;
}

void evse_advance(struct evse *e, int64_t now_ms)
{
	int64_t dt = now_ms - e->last_ms;

	if (dt <= 0) {
		return;
	}

	/* the power only changes in settle(), so it was constant since last_ms */
	e->energy_wms += (uint64_t)e->power_w * dt;
	e->last_ms = now_ms;

	settle(e, now_ms);
}

void evse_set_plugged(struct evse *e, bool plugged, int64_t now_ms)
{
	evse_advance(e, now_ms);

	if (e->ev_plugged && !plugged &&
	    (e->auth == EVSE_AUTH_REJECTED || e->auth == EVSE_AUTH_FAILED)) {
		e->auth = EVSE_AUTH_NONE;
	}
	e->ev_plugged = plugged;

	settle(e, now_ms);
}

void evse_set_ev_ready(struct evse *e, bool ready, int64_t now_ms)
{
	evse_advance(e, now_ms);
	e->ev_ready = ready;
	settle(e, now_ms);
}

void evse_set_evse_ready(struct evse *e, bool ready, int64_t now_ms)
{
	evse_advance(e, now_ms);
	e->evse_ready = ready;
	settle(e, now_ms);
}

void evse_set_fault(struct evse *e, bool faulted, int64_t now_ms)
{
	evse_advance(e, now_ms);
	e->faulted = faulted;
	settle(e, now_ms);
}

void evse_set_inoperative(struct evse *e, bool inoperative, int64_t now_ms)
{
	evse_advance(e, now_ms);
	e->inoperative = inoperative;
	settle(e, now_ms);
}

void evse_set_limit(struct evse *e, uint32_t limit_w, int64_t now_ms)
{
	evse_advance(e, now_ms);
	e->limit_w = MIN(limit_w, e->cfg.max_power_w);
	settle(e, now_ms);
}

bool evse_is_idle(const struct evse *e)
{
	return e->txn == EVSE_TXN_IDLE && e->auth != EVSE_AUTH_PENDING &&
	       e->auth != EVSE_AUTH_ACCEPTED && !e->faulted && !e->inoperative;
}

static int check_idtag(const char *idtag)
{
	size_t len;

	if (idtag == NULL) {
		return -EINVAL;
	}
	len = strlen(idtag);
	if (len == 0 || len > EVSE_IDTAG_MAX) {
		return -EINVAL;
	}

	return 0;
}

static int begin_authorize(struct evse *e, const char *idtag)
{
	if (e->faulted || e->inoperative) {
		return -EACCES;
	}

	strcpy(e->idtag, idtag);
	e->auth = EVSE_AUTH_PENDING;
	e->request = EVSE_REQ_AUTHORIZE;

	return 0;
}

int evse_present_tag(struct evse *e, const char *idtag, int64_t now_ms)
{
	int ret = check_idtag(idtag);

	if (ret < 0) {
		return ret;
	}

	evse_advance(e, now_ms);

	if (e->auth == EVSE_AUTH_PENDING || e->txn == EVSE_TXN_STARTING ||
	    e->txn == EVSE_TXN_STOPPING) {
		return -EBUSY;
	}

	if (e->txn == EVSE_TXN_ACTIVE || e->auth == EVSE_AUTH_ACCEPTED) {
		/* only the identifier that started the session ends it */
		if (strcmp(e->idtag, idtag) != 0) {
			return -EBUSY;
		}
		return evse_stop(e, EVSE_STOP_LOCAL, now_ms);
	}

	ret = begin_authorize(e, idtag);
	settle(e, now_ms);

	return ret;
}

int evse_remote_start(struct evse *e, const char *idtag, int64_t now_ms)
{
	int ret = check_idtag(idtag);

	if (ret < 0) {
		return ret;
	}

	evse_advance(e, now_ms);

	if (e->faulted || e->inoperative) {
		return -EACCES;
	}
	if (!evse_is_idle(e)) {
		return -EBUSY;
	}

	ret = begin_authorize(e, idtag);
	settle(e, now_ms);

	return ret;
}

int evse_stop(struct evse *e, enum evse_stop_reason reason, int64_t now_ms)
{
	int ret = 0;

	evse_advance(e, now_ms);

	if (e->txn == EVSE_TXN_ACTIVE) {
		e->txn = EVSE_TXN_STOPPING;
		e->request = EVSE_REQ_STOP_TXN;
		e->stop_reason = reason;
	} else if (e->txn == EVSE_TXN_STARTING) {
		e->stop_pending = reason;
	} else if (e->txn == EVSE_TXN_IDLE && e->auth == EVSE_AUTH_ACCEPTED) {
		e->auth = EVSE_AUTH_NONE;
	} else {
		ret = -EALREADY;
	}

	settle(e, now_ms);

	return ret;
}

enum evse_request evse_take_request(struct evse *e)
{
	enum evse_request request = e->request;

	e->request = EVSE_REQ_NONE;

	return request;
}

void evse_auth_result(struct evse *e, enum evse_result result, int64_t now_ms)
{
	evse_advance(e, now_ms);

	if (e->auth != EVSE_AUTH_PENDING) {
		return;
	}

	switch (result) {
	case EVSE_RESULT_ACCEPTED:
		e->auth = EVSE_AUTH_ACCEPTED;
		e->auth_deadline_ms = now_ms + (int64_t)e->cfg.auth_timeout_s * 1000;
		break;
	case EVSE_RESULT_REJECTED:
		e->auth = EVSE_AUTH_REJECTED;
		break;
	default:
		e->auth = EVSE_AUTH_FAILED;
		break;
	}

	settle(e, now_ms);
}

void evse_txn_started(struct evse *e, enum evse_result result, int32_t txn_id, int64_t now_ms)
{
	evse_advance(e, now_ms);

	if (e->txn != EVSE_TXN_STARTING) {
		return;
	}

	if (result == EVSE_RESULT_ACCEPTED) {
		e->txn = EVSE_TXN_ACTIVE;
		e->txn_id = txn_id;
		e->last_txn_id = txn_id;
		e->txn_start_ms = now_ms;
		e->txn_end_ms = now_ms;
		e->session_start_wms = e->energy_wms;
		e->stop_reason = EVSE_STOP_NONE;
		if (e->stop_pending != EVSE_STOP_NONE) {
			e->txn = EVSE_TXN_STOPPING;
			e->request = EVSE_REQ_STOP_TXN;
			e->stop_reason = e->stop_pending;
		}
	} else {
		e->txn = EVSE_TXN_IDLE;
		e->txn_id = -1;
		e->auth = result == EVSE_RESULT_REJECTED ? EVSE_AUTH_REJECTED : EVSE_AUTH_FAILED;
	}
	e->stop_pending = EVSE_STOP_NONE;

	settle(e, now_ms);
}

void evse_txn_stopped(struct evse *e, int64_t now_ms)
{
	evse_advance(e, now_ms);

	if (e->txn != EVSE_TXN_STOPPING) {
		return;
	}

	e->txn = EVSE_TXN_IDLE;
	e->txn_id = -1;
	e->txn_end_ms = now_ms;
	e->auth = EVSE_AUTH_NONE;
	e->finishing = e->ev_plugged;

	settle(e, now_ms);
}

enum evse_status evse_status(const struct evse *e)
{
	if (e->faulted) {
		return EVSE_STATUS_FAULTED;
	}

	switch (e->txn) {
	case EVSE_TXN_ACTIVE:
		if (!e->evse_ready) {
			return EVSE_STATUS_SUSPENDED_EVSE;
		}
		if (!e->ev_ready || !e->ev_plugged) {
			return EVSE_STATUS_SUSPENDED_EV;
		}
		return EVSE_STATUS_CHARGING;
	case EVSE_TXN_STOPPING:
		return EVSE_STATUS_FINISHING;
	case EVSE_TXN_STARTING:
		return EVSE_STATUS_PREPARING;
	default:
		break;
	}

	if (e->inoperative) {
		return EVSE_STATUS_UNAVAILABLE;
	}
	if (e->finishing && e->ev_plugged) {
		return EVSE_STATUS_FINISHING;
	}
	if (e->ev_plugged || e->auth == EVSE_AUTH_PENDING || e->auth == EVSE_AUTH_ACCEPTED) {
		return EVSE_STATUS_PREPARING;
	}

	return EVSE_STATUS_AVAILABLE;
}

uint32_t evse_energy_wh(const struct evse *e)
{
	return (uint32_t)(e->energy_wms / WMS_PER_WH);
}

uint32_t evse_session_wh(const struct evse *e)
{
	return (uint32_t)((e->energy_wms - e->session_start_wms) / WMS_PER_WH);
}

uint32_t evse_session_s(const struct evse *e)
{
	int64_t end = e->txn == EVSE_TXN_IDLE ? e->txn_end_ms : e->last_ms;

	return (uint32_t)((end - e->txn_start_ms) / 1000);
}

static uint32_t phase_current_ma(const struct evse *e, uint32_t power_w)
{
	uint32_t volts = (uint32_t)e->cfg.voltage_v * e->cfg.phases;

	if (volts == 0) {
		return 0;
	}

	return (uint32_t)((uint64_t)power_w * 1000 / volts);
}

uint32_t evse_current_ma(const struct evse *e)
{
	return phase_current_ma(e, e->power_w);
}

uint32_t evse_offered_ma(const struct evse *e)
{
	return phase_current_ma(e, MIN(e->limit_w, e->cfg.max_power_w));
}

uint16_t evse_voltage_v(const struct evse *e)
{
	return delivering(e) ? e->cfg.voltage_v : 0;
}

const char *evse_status_str(enum evse_status status)
{
	static const char *const names[EVSE_STATUS_COUNT] = {
		[EVSE_STATUS_AVAILABLE] = "Available",
		[EVSE_STATUS_PREPARING] = "Preparing",
		[EVSE_STATUS_CHARGING] = "Charging",
		[EVSE_STATUS_SUSPENDED_EV] = "SuspendedEV",
		[EVSE_STATUS_SUSPENDED_EVSE] = "SuspendedEVSE",
		[EVSE_STATUS_FINISHING] = "Finishing",
		[EVSE_STATUS_UNAVAILABLE] = "Unavailable",
		[EVSE_STATUS_FAULTED] = "Faulted",
	};

	if ((unsigned int)status >= EVSE_STATUS_COUNT) {
		return "?";
	}

	return names[status];
}

const char *evse_auth_str(enum evse_auth auth)
{
	switch (auth) {
	case EVSE_AUTH_NONE:
		return "None";
	case EVSE_AUTH_PENDING:
		return "Pending";
	case EVSE_AUTH_ACCEPTED:
		return "Accepted";
	case EVSE_AUTH_REJECTED:
		return "Rejected";
	case EVSE_AUTH_FAILED:
		return "No answer";
	default:
		return "?";
	}
}

const char *evse_stop_reason_str(enum evse_stop_reason reason)
{
	switch (reason) {
	case EVSE_STOP_NONE:
		return "None";
	case EVSE_STOP_LOCAL:
		return "Local";
	case EVSE_STOP_REMOTE:
		return "Remote";
	case EVSE_STOP_EV_DISCONNECTED:
		return "EVDisconnected";
	default:
		return "?";
	}
}
```

## src/host.h
```c
/*
 * Copyright (c) 2026 Muhammad Waleed Badar
 * SPDX-License-Identifier: Apache-2.0
 *
 * native_sim only: command line options and the host's clock.
 */
#ifndef OCPP_SIM_APP_HOST_H_
#define OCPP_SIM_APP_HOST_H_

#include <errno.h>
#include <stdint.h>

#include <zephyr/toolchain.h>

#if defined(CONFIG_BOARD_NATIVE_SIM)

/* Set the clock and apply --url, --id and --page; after config_init() */
void host_init(void);

/* On the main thread, every loop: takes the screenshots that are due */
void host_poll(int64_t now_ms);

/* Write the screen to a binary PPM at the next host_poll(). Any thread. */
int host_request_shot(const char *path);

/* Touch the display at x, y for a moment, as the mouse would. Any thread. */
int host_tap(int x, int y);

#else

static inline void host_init(void)
{
}

static inline void host_poll(int64_t now_ms)
{
	ARG_UNUSED(now_ms);
}

static inline int host_request_shot(const char *path)
{
	ARG_UNUSED(path);

	return -ENOTSUP;
}

static inline int host_tap(int x, int y)
{
	ARG_UNUSED(x);
	ARG_UNUSED(y);

	return -ENOTSUP;
}

#endif /* CONFIG_BOARD_NATIVE_SIM */

#endif /* OCPP_SIM_APP_HOST_H_ */
```

## src/net.c
```c
/*
 * Copyright (c) 2026 Muhammad Waleed Badar
 * SPDX-License-Identifier: Apache-2.0
 */

#include "net.h"

#include <errno.h>
#include <string.h>

#include <zephyr/logging/log.h>
#include <zephyr/net/net_if.h>
#include <zephyr/net/net_mgmt.h>
#include <zephyr/net/socket.h>
#include <zephyr/sys/clock.h>

#if defined(CONFIG_NET_CONNECTION_MANAGER)
#include <zephyr/net/conn_mgr_monitor.h>
#endif
#if defined(CONFIG_SNTP)
#include <zephyr/net/sntp.h>
#endif

LOG_MODULE_REGISTER(net, LOG_LEVEL_INF);

#if defined(CONFIG_NET_CONNECTION_MANAGER)

static K_SEM_DEFINE(l4_up, 0, 1);
static struct net_mgmt_event_callback l4_cb;
static bool l4_registered;

static void l4_handler(struct net_mgmt_event_callback *cb, uint64_t event, struct net_if *iface)
{
	ARG_UNUSED(cb);
	ARG_UNUSED(iface);

	if (event == NET_EVENT_L4_CONNECTED) {
		k_sem_give(&l4_up);
	}
}

int net_wait_ready(k_timeout_t timeout)
{
	if (!l4_registered) {
		l4_registered = true;
		net_mgmt_init_event_callback(&l4_cb, l4_handler, NET_EVENT_L4_CONNECTED);
		net_mgmt_add_event_callback(&l4_cb);
		conn_mgr_mon_resend_status();
	}

	return k_sem_take(&l4_up, timeout) == 0 ? 0 : -ETIMEDOUT;
}

#else

/* Offloaded sockets (native_sim) and static addresses: nothing to wait for */
int net_wait_ready(k_timeout_t timeout)
{
	ARG_UNUSED(timeout);

	return 0;
}

#endif /* CONFIG_NET_CONNECTION_MANAGER */

int net_resolve(const char *host, char *ip, size_t len)
{
	struct zsock_addrinfo hints = {
		.ai_family = NET_AF_INET,
		.ai_socktype = NET_SOCK_STREAM,
	};
	struct zsock_addrinfo *res = NULL;
	struct net_in_addr addr;
	int ret;

	/* an address needs no resolver */
	if (zsock_inet_pton(NET_AF_INET, host, &addr) == 1) {
		if (strlen(host) >= len) {
			return -ENAMETOOLONG;
		}
		strcpy(ip, host);
		return 0;
	}

	ret = zsock_getaddrinfo(host, NULL, &hints, &res);
	if (ret != 0 || res == NULL) {
		LOG_WRN("cannot resolve %s (%d)", host, ret);
		return -EHOSTUNREACH;
	}

	if (zsock_inet_ntop(NET_AF_INET, &net_sin(res->ai_addr)->sin_addr, ip, len) == NULL) {
		ret = -ENAMETOOLONG;
	}
	zsock_freeaddrinfo(res);

	return ret;
}

void net_sync_time(void)
{
#if defined(CONFIG_SNTP)
	struct sntp_time now;
	struct timespec ts;
	int ret;

	ret = sntp_simple(CONFIG_OCPP_SIM_APP_SNTP_SERVER, 4000, &now);
	if (ret < 0) {
		LOG_WRN("SNTP %s: %d, timestamps start at 1970", CONFIG_OCPP_SIM_APP_SNTP_SERVER,
			ret);
		return;
	}

	ts.tv_sec = now.seconds;
	ts.tv_nsec = 0;
	sys_clock_settime(SYS_CLOCK_REALTIME, &ts);
	LOG_INF("time set from %s", CONFIG_OCPP_SIM_APP_SNTP_SERVER);
#endif
}
```
